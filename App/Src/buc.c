#include "buc.h"
#include "stdlib.h"
#include "uart_api.h"

BUC_Data_t BUC_Data;

uint8_t BUC_RecvLength = 0;
uint8_t BUC_RecvCount = 0;
uint8_t BUC_RecvBuff[50];
uint8_t BUC_RecvFlag = 0;

uint16_t BUC_Calc_CRC16(uint8_t* Packet, uint16_t dwLength)
{
    static uint16_t CRC16_TABLE[256] = {
        0x0000, 0x1021, 0x2042, 0x3063, 0x4084, 0x50a5, 0x60c6, 0x70e7,
        0x8108, 0x9129, 0xa14a, 0xb16b, 0xc18c, 0xd1ad, 0xe1ce, 0xf1ef,
        0x1231, 0x0210, 0x3273, 0x2252, 0x52b5, 0x4294, 0x72f7, 0x62d6,
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        0x6e17, 0x7e36, 0x4e55, 0x5e74, 0x2e93, 0x3eb2, 0x0ed1, 0x1ef0
    };
    uint16_t CRC16 = 0x0000;
    uint16_t i;
    for (i = 0; i < dwLength; i++) {
        CRC16 = ((CRC16 << 8) | Packet[i]) ^ CRC16_TABLE[(CRC16 >> 8) & 0xFF];
    }
    for (i = 0; i < 2; i++) {
        CRC16 = ((CRC16 << 8) | 0) ^ CRC16_TABLE[(CRC16 >> 8) & 0xFF];
    }
    return CRC16;
}

//功放控制
void BUC_Ctrl(BUC_CMD_t cmd, uint32_t arg)
{
    uint8_t cnt = 0;
    uint16_t cs = 0;
    uint8_t buff[10] = { 0 };

    buff[cnt++] = 0xF6;
    buff[cnt++] = 0x00;
    buff[cnt++] = cmd;
    switch (cmd) {
    case SET_GAIN:
        buff[cnt++] = (arg >> 8) & 0xFF;
        buff[cnt++] = (arg >> 0) & 0xFF;
        break;
    case SET_SWITCH:
        buff[cnt++] = arg;
        break;
    case SET_REBOOT:
        buff[cnt++] = 0x00;
        break;
    case SET_IP_ADDR:
    case SET_IP_MASK:
    case SET_IP_GW:
        buff[cnt++] = (arg >> 24) & 0xFF;
        buff[cnt++] = (arg >> 16) & 0xFF;
        buff[cnt++] = (arg >> 8) & 0xFF;
        buff[cnt++] = (arg >> 0) & 0xFF;
        break;

    default:
        break;
    }

    buff[1] = cnt;

    cs = BUC_Calc_CRC16(&buff[1], cnt - 1);

    buff[cnt++] = (cs >> 8) & 0xFF;
    buff[cnt++] = (cs >> 0) & 0xFF;

    buff[cnt++] = 0x16;

    // DmaSendData(BUC_TX_STREAM, BUC_TX_BUFF, buff, cnt);
}

//IP地址转换
//参数：IP地址
//  如地址为192.168.0.1则调用 BUC_CoverIP(192, 168, 0, 1);
uint32_t BUC_CoverIP(uint8_t addr0, uint8_t addr1, uint8_t addr2, uint8_t addr3)
{
    return ((addr3 << 24) + (addr2 << 16) + (addr1 << 8) + addr0);
}

//功放增益转换
//参数：功率
uint32_t BUC_CoverGain(float value)
{
    return (value * 10);
}

void AnalysisBUC(uint8_t* buff, uint8_t len)
{
    if (buff == NULL || buff[0] != 0xF2) {
        return;
    }

    uint16_t cs = BUC_Calc_CRC16(&buff[1], buff[1] - 1);

    if (((cs >> 8) & 0xFF) != buff[buff[1]] || ((cs >> 0) & 0xFF) != buff[buff[1] + 1]) {
        return;
    }

    switch (buff[2]) {
    case SET_GAIN:
    case SET_SWITCH:
    case SET_REBOOT:
    case SET_IP_ADDR:
    case SET_IP_MASK:
    case SET_IP_GW:
        BUC_Data.setErrCode = buff[3];
        break;
    case GET_RANGE:
        BUC_Data.rangeMax = buff[4] + (buff[5] << 8);
        break;
    case GET_GAIN:
        BUC_Data.gain = (buff[4] + (buff[5] << 8)) / 10.0f;
        break;
    case GET_POWER:
        BUC_Data.power = (buff[4] + (buff[5] << 8)) / 10.0f;
        break;
    case GET_SWITCH:
        BUC_Data.state = buff[4];
        break;
    default:
        break;
    }

    return;
}
